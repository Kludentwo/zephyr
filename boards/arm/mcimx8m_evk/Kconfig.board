## boards/arm/mcimx8m_evk/Kconfig.board
```kconfig
# Kconfig - MCIMX8M-EVK board
#
# Copyright (c) 2019, Prevas A/S
#
# SPDX-License-Identifier: Apache-2.0
#

config BOARD_MCIMX8M_EVK_M4
	bool "MCIMX8M-EVK"
	depends on SOC_SERIES_IMX8_M4
	select SOC_PART_NUMBER_MIMX8MQ6CVAHZ
```

## boards/shields/adafruit_winc1500/Kconfig.defconfig
```kconfig
# Copyright (c) 2020 Kim Bøndergaard <kim.bondergaard@prevas.dk>, Prevas A/S
# SPDX-License-Identifier: Apache-2.0

if SHIELD_ADAFRUIT_WINC1500

config SPI
	default y

config WIFI_WINC1500
	default y

config WIFI
	default y

endif # SHIELD_ADAFRUIT_WINC1500
```

## dts/bindings/pinctrl/nxp,kinetis-pinmux.yaml
```yaml
description: Kinetis pinmux node

compatible: "nxp,kinetis-pinmux"

include: base.yaml

properties:
    reg:
      required: true

    clocks:
      required: true

child-binding:
    title: foo
    description: bar
    properties:
      pin:
        required: true
        type: int

      mux:
        required: true
        type: int
```

## soc/arm/nxp_imx/mimx8mq6_m4/Kconfig.defconfig.mimx8mq6_m4
```kconfig
# Kconfig - iMX8 M4 core series
#
# Copyright (c) 2019, Prevas A/S
#
# SPDX-License-Identifier: Apache-2.0
#

if SOC_MIMX8MQ6_M4

config SOC
	string
	default "mimx8mq6_m4"

config SYS_CLOCK_HW_CYCLES_PER_SEC
	int
	default 200000000

if CLOCK_CONTROL

config CLOCK_CONTROL_IMX_CCM
	default y

endif # CLOCK_CONTROL

if SERIAL

config UART_IMX
	default y

endif # SERIAL

if IPM

config IPM_IMX
	default y

endif # IPM

endif # SOC_MCIMX7_M4
```

## soc/arm/nxp_imx/mimx8mq6_m4/Kconfig.defconfig.series
```kconfig
# Kconfig - iMX8 M4 core series
#
# Copyright (c) 2019, Prevas A/S
#
# SPDX-License-Identifier: Apache-2.0
#

if SOC_SERIES_IMX8_M4

config SOC_SERIES
	default "mimx8mq6"

config NUM_IRQS
	int
	# must be >= the highest interrupt number used
	default 127

source "soc/arm/nxp_imx/mimx8mq6_m4/Kconfig.defconfig.mimx8mq6_m4"

endif # SOC_SERIES_IMX8_M4
```

## soc/arm/nxp_imx/mimx8mq6_m4/Kconfig.soc
```kconfig
# Kconfig - iMX7 M4 core series
#
# Copyright (c) 2019, Prevas A/S
#
# SPDX-License-Identifier: Apache-2.0
#

choice
prompt "i.MX8 M4 Selection"
depends on SOC_SERIES_IMX8_M4

config SOC_MIMX8MQ6_M4
	bool "SOC_MIMX8MQ6_M4"
	select HAS_MCUX
	select HAS_MCUX_IMX_HAL
	select HAS_MCUX_CCM
	select CPU_HAS_ARM_MPU


endchoice

if SOC_MIMX8MQ6_M4

config SOC_PART_NUMBER_MIMX8MQ6CVAHZ
	bool

config SOC_PART_NUMBER_MIMX8MQ6DVAJZ
	bool

config SOC_PART_NUMBER_IMX8_M4
	string
	default "MIMX8MQ6CVAHZ" if SOC_PART_NUMBER_MIMX8MQ6CVAHZ
	default "MIMX8MQ6DVAJZ" if SOC_PART_NUMBER_MIMX8MQ6DVAJZ
	help
	  This string holds the full part number of the SoC. It is a hidden option
	  that you should not set directly. The part number selection choice defines
	  the default value for this string.

endif # SOC_SERIES_IMX8_M4
```
